/dts-v1/;
/plugin/;

/ {
	compatible = "bananapi,bpi-r4", "mediatek,mt7988a";

	fragment@0 {
		target-path = "/soc/mmc@11230000";
		__overlay__ {
			bus-width = <4>;
			max-frequency = <52000000>;
			cap-sd-highspeed;
			status = "okay";
		};
	};
};
